/*
 * Device Tree Include file for Kontron SMARC-sAL28.
 */

/dts-v1/;
/plugin/;

/ {
	compatible = "kontron,sl28", "fsl,ls1028a";

	fragment@0 {
		target = <&i2c4>;
		__overlay__ {
			clock-frequency = <400000>;
		};
	};
};
