/*
 * Device Tree Include file for Kontron SMARC-sAL28.
 */

/dts-v1/;
/plugin/;

/ {
	compatible = "kontron,sl28", "fsl,ls1028a";

	fragment@0 {
		target = <&display1>;

		__overlay__ {
			#address-cells = <0x1>;
			#size-cells = <0x0>;

			fsl,no_edid;
			fsl,edp;

			edp_link_rate = <0xa>;
			edp_num_lanes = <0x2>;
		};
	};
};
